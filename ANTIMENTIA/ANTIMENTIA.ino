#include "funk.h"
#include <PCM.h>
int n = 1;
boolean f = false;
#define win 7
#define lose 9


const unsigned char won[] PROGMEM = {
  120, 103, 85, 83, 149, 192, 188, 152, 121, 103, 101, 115,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 124,
};

const unsigned char lost[] PROGMEM = {
  102, 117, 125, 148, 152, 112, 94, 137, 149, 132, 126, 132,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 128,
};


void setup() {

  Serial.begin(38400);
  //DDRC = 0x00;
  //PORTC |= 0xfe;
  pinMode(A5, INPUT_PULLUP);
  pinMode(A4, INPUT_PULLUP);
  pinMode(A3, INPUT_PULLUP);
  pinMode(A2, INPUT_PULLUP);
  pinMode(A1, INPUT_PULLUP);
  pinMode(A0, INPUT);

  pinMode(win, OUTPUT);
  pinMode(lose, OUTPUT);
  randomSeed((analogRead(A0)*analogRead(A0)) * 12279);


  for (int j = 2; j <= 6; j++)
    pinMode(j, OUTPUT);

  for (;;)
  {

    byte *p = (byte *)malloc(n);

    for (int i = 0; i < n; i++)
      p[i] = random(2, 7);

    showSequence(p, n);

    int j = 0;

    while (j < n)
    {
      /*Serial.print(j);
        Serial.print(" ");
        Serial.println(PINC & 0x3e, HEX);*/

      for (int i = 0; i < n; i++)
      {
        Serial.print(p[i]);
        Serial.print(" ");
      }
      Serial.println();

      if (map(PINC & 0x3e) == p[j] && f)      
      {
        j++;
        f = false;
      }
      if (map(PINC & 0x3e) != p[j] && map(PINC & 0x3e) != 0 && f)
      {
        Serial.println("You Lost, Try Again!");
        f = false;
        startPlayback(lost, sizeof(lost));
        midSeq(lose);
        break;
      }

      if (map(PINC & 0x3e) == 0)
        f = true;

    }

    if (j == n)
    {
      Serial.println("You Won, Level Up!");
      startPlayback(won, sizeof(won));

      Serial.print("Level ");
      n++;
      Serial.println(n);
      midSeq(win);
    }

    randomSeed(analogRead(A0)*sqrt(analogRead(A0)));

    free(p);
    digitalWrite(win, LOW);
    digitalWrite(lose, LOW);
    delay(2300);

  }
}
